## config/boards/shields/corne_eclipse/Kconfig.shield
```kconfig
# Copyright (c) 2020 Pete Johanson
# SPDX-License-Identifier: MIT

config SHIELD_CORNE_ECLIPSE_LEFT
    def_bool $(shields_list_contains,corne_eclipse_left)

config SHIELD_CORNE_ECLIPSE_RIGHT
    def_bool $(shields_list_contains,corne_eclipse_right)
```

## config/boards/shields/eclipse_nice_view_adapter_trrs/Kconfig.shield
```kconfig
# Copyright (c) 2022 The ZMK Contributors
# SPDX-License-Identifier: MIT

config SHIELD_ECLIPSE_NICE_VIEW_ADAPTER_TRRS
    def_bool $(shields_list_contains,eclipse_nice_view_adapter_trrs)
```
